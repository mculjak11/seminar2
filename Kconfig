## Kconfig
```kconfig
# This Kconfig file is picked by the Zephyr build system because it is defined
# as the module Kconfig entry point (see zephyr/module.yml). You can browse
# module options by going to Zephyr -> Modules in Kconfig.

menu "Sensor"
    choice SENSOR
        bool "Active SHT3x sensor"
        default y
    endchoice
endmenu
    
```

## app/sample.yaml
```yaml
sample:
  name: Zephyr Seminar Example
common:
  platform_allow: esp32 stm32f4 nrf51
  tags: sensors
```

&i2c1 { /* SDA B9, SCL B8*/
    pinctrl-0 = <&i2c1_scl_pb8 &i2c1_sda_pb9>;
	pinctrl-names = "default";
	status = "okay";
	clock-frequency = <I2C_BITRATE_STANDARD>;
	sht3xd@44 {
		compatible = "sensirion,sht3xd";
		reg = <0x44>;
	};
};